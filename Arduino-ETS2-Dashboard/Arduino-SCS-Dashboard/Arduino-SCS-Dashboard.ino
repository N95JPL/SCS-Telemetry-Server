#include <LiquidCrystal.h>
#include <SPI.h>
#include <MCUFRIEND_kbv.h>
#include <ArduinoJson.h>


//#pragma GCC optimize("-O3")

//#define LCD_CS A3 // Chip Select goes to Analog 3
//#define LCD_CD A2 // Command/Data goes to Analog 2
//#define LCD_WR A1 // LCD Write goes to Analog 1
//#define LCD_RD A0 // LCD Read goes to Analog 0
//#define LCD_RESET A4 // Can alternately just connect to Arduino's reset pin

MCUFRIEND_kbv tft;
//LiquidCrystal lcd(8,9,4,5,6,7);
LiquidCrystal lcd(31,33,35,37,39,41);
//(LCD_CS, LCD_CD, LCD_WR, LCD_RD, LCD_RESET)
//#include <Adafruit_TFTLCD.h>
//Adafruit_TFTLCD tft;

#define	BLACK   0x0000
#define	BLUE    0x001F
#define	RED     0xF800
#define	GREEN   0x07E0
#define CYAN    0x07FF
#define MAGENTA 0xF81F
#define YELLOW  0xFFE0
#define WHITE   0xFFFF

const uint8_t fuel[] PROGMEM = { 0x00,0x00,0x00,0x00,0x00,0x00,0x00,0x00,0x00,0x00,0x00,0x00,0x00,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0x00,0x00 };
const uint8_t parkingBrake[] PROGMEM = { 0x00,0x00,0x00,0x00,0x00,0x00,0x00,0x00,0x00,0x00,0x00,0x1f,0xf8,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0x00,0x00 };
const uint8_t engineBrake[] PROGMEM = { 0x00,0x00,0x00,0x00,0x00,0x00,0x00,0x00,0x00,0x00,0x00,0x1f,0xf8,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0x00,0x00 };
const uint8_t retarderBrake[] PROGMEM = { 0x00,0x00,0x00,0x00,0x00,0x00,0x00,0x00,0x00,0x00,0x00,0x1f,0xf8,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0x00,0x00 };
const uint8_t cruiseControl[] PROGMEM = { 0x00,0x01,0xfc,0x00,0x00,0x00,0x0f,0xff,0x80,0x00,0x00,0x3f,0xff,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0x06,0x00 };
const uint8_t airPressure[] PROGMEM = { 0x00,0x00,0x00,0x00,0x00,0x00,0x00,0x00,0x00,0x00,0x00,0x1f,0xf8,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0x00,0x00 };

size_t capacity = JSON_OBJECT_SIZE(1) + JSON_OBJECT_SIZE(7) + JSON_OBJECT_SIZE(11) + 400;
DynamicJsonDocument doc(capacity);
JsonObject truck = doc["truck"];
//JsonObject warning = doc["warning"];

uint16_t screenX = 480;
uint16_t screenY = 320;
String gameTime = "Mon - 08:00";
String gameRadio = "Awaiting Server";
String truck_Speed = "--";
String truck_Gear = "A"; // "A12"
float truck_Fuel = 0.001; // "100"
String truck_Range = "Range"; // 1700
String truck_AirPressure = "0psi"; // 100
String truck_airPressureWarn = "Normal";
String truck_BrakeTemperature = "0�C";
String ViewScreen = "Driving";
String truck_CruiseSpeed = "--"; // 0
bool truck_ParkingB = true; // true
bool truck_Cruise; // false
bool truck_EngineB = false; // true
int truck_Retarder = 0; // 0

String CurrentCity = ""; // "Varna"
String CurrentCountry = ""; // "Bulgaria"

bool locationChange = false;
bool locationCityChange = false;
bool locationCountryChange = false;
String locationCurrent = "---";

int MessageBeginTime;
int lastUIRefresh;
bool NotificationScreen = false;
bool firstLoop = true;
bool Change = false;
//uint16_t ID = 0x9486;

uint16_t temp2color(int degree, int lo, int hi)
{
    uint8_t r, g, b;
    r = map(degree, lo, hi, 255, 0);
    g = map(degree, lo, hi, 0, 255);
    b = 0;
    return tft.color565(r, g, b);
}

void setup() {
    pinMode(69, INPUT);
    uint16_t ID = tft.readID();
    Serial.begin(57600);
    Serial1.begin(9600);
    while(!Serial){
      delay(100);
    }
    Serial.setTimeout(100);
    Serial.println(ID);
    tft.reset();
    tft.begin(ID);
    tft.fillScreen(BLACK);
    tft.setRotation(3);
    drawMainUI();
    tft.drawBitmap(380, 14, cruiseControl, 37, 32, WHITE);
    tft.setTextSize(6);
    writeCentreScreenText("Welcome!");
    lcd.begin(16, 2);
    lcd.setCursor(0,1);
    lcd.print("Awaiting Server");
    tft.setTextSize(3);
    tft.setCursor(427,20);
    tft.print(truck_CruiseSpeed);
    delay(2000);
    clearUIArea();
}

void loop() {
    if (millis() > lastUIRefresh + 15000) {
        drawMainUI();
    }
    if (Serial.available() > 0)
    {
        String Message = Serial.readStringUntil('\n');
        
        deserializeJson(doc, Message, DeserializationOption::NestingLimit(30));
        truck = doc["truck"];
        if (NotificationScreen == true) {
            if (millis() < MessageBeginTime + 2000) {
                updateMainInfo();
            }
            else
            {
                NotificationScreen = false;
                clearUIArea();
                updateMainInfo();
                Change = true;
            }
        }
        else {
            updateMainInfo();
            if (!doc["ScreenView"].as<String>().equals(ViewScreen))
            {
                ViewScreen = doc["ScreenView"].as<String>();
                clearUIArea();
                Change = true;
            }
            if (!doc["GameRadio"].as<String>().equals(gameRadio))
            {
                gameRadio = doc["GameRadio"].as<String>();
                lcd.clear();
                lcd.print(gameRadio);
            }
            if (firstLoop)
            {
                //writeCentrePointText(truck_CruiseSpeed, 450, 25);
                firstLoop = false;
                Change = true;
            }
            if (ViewScreen == "Driving") { Driving(Change); }
            else if (ViewScreen == "Brakes") { Brakes(Change); }
            tft.drawRoundRect(10, 10, 80, 40, 20, WHITE);
            Change = false;
        }
        Serial.readString();
    }
    else{
        Serial.println("A");
    }
    int key_in = analogRead(A15);
    //RIGHT 0
    //UP 130
    //DOWN 306
    //LEFT 479
    //SELECT 720
    //Serial.println(analogRead(A15));
    if (key_in < 60) {
      Serial.println("RIGHT");
    }
      else if (key_in < 200) {
      Serial.println("UP");
    }
      else if (key_in < 400){
      Serial.println("DOWN");
    }
      else if (key_in < 600){
      Serial.println("LEFT");
   }
      else if (key_in < 800){
      Serial.println("SELECT");
   }
}


void updateMainInfo()
{
    if (!truck["Gear"].as<String>().equals(truck_Gear) && truck["Gear"].as<String>() != NULL) {
        tft.setTextSize(3);
        removeCentrePointText(truck_Gear, 45, 25);
        truck_Gear = truck["Gear"].as<String>();
        writeCentrePointText(truck_Gear, 45, 25);
    }
    if (!doc["GameTime"].as<String>().equals(gameTime) && doc["GameTime"].as<String>() != NULL) {
        tft.setTextSize(4);
        removeCentreText(gameTime, 30);
        gameTime = doc["GameTime"].as<String>();
        writeCentreText(gameTime, 30);
    }
    if (!(truck["CruiseSpeed"].as<String>() == truck_CruiseSpeed) && truck["CruiseSpeed"].as<String>() != NULL) {
            tft.setTextSize(3);
            removeText(truck_CruiseSpeed, 427, 20);
            truck_CruiseSpeed = truck["CruiseSpeed"].as<String>();
            tft.setCursor(427,20);
            tft.print(truck_CruiseSpeed);
    }
    if (doc["CurrentCity"].as<String>() != CurrentCity && doc["CurrentCity"].as<String>() != NULL) {
        /*tft.setTextSize(3);
        removeText(CurrentCity, 10, 290);*/
        CurrentCity = doc["CurrentCity"].as<String>();
        locationChange = true;
        locationCityChange = true;
        /*tft.setCursor(10, 290);
        tft.print(CurrentCity);*/
    }
    if (doc["CurrentCountry"].as<String>() != CurrentCountry && doc["CurrentCountry"].as<String>() != NULL) {
        /*tft.setTextSize(3);
        removeText(CurrentCity, 10, 290);*/
        CurrentCountry = doc["CurrentCountry"].as<String>();
        locationCountryChange = true;
        locationChange = true;
        /*tft.setCursor(10, 290);
        tft.print(CurrentCity);*/
    }
    if (locationChange == true) {
        tft.setTextSize(3);
        removeCentreText(locationCurrent, 305);
        locationCurrent = (String)CurrentCity + ", " + (String)CurrentCountry;
        if (locationCountryChange == true) {
            Notification("Info", "Country", CurrentCountry);
        }
        writeCentreText(locationCurrent, 305);
        locationChange = false;
    }
    if (truck["Cruise"] != truck_Cruise) {
        truck_Cruise = truck["Cruise"];
        if (truck_Cruise == true) {
            tft.drawBitmap(380, 14, cruiseControl, 37, 32, GREEN);
        } else if (truck_Cruise == false) { tft.drawBitmap(380, 14, cruiseControl, 37, 32, WHITE); }
    }
}
void Notification(String Level, String Type, String Values) {
    if (firstLoop == false) {
        drawNotification(Level);
        if (Level == "Info") {
            if (Type == "Country") {
                tft.setTextSize(3);
                writeCentreText("Welcome to " + CurrentCountry +"!", 120);
            }
        }
        locationChange = false;
        locationCountryChange = false;
        locationCityChange = false;
        MessageBeginTime = millis();
        NotificationScreen = true;
    }
    locationChange = false;
    locationCountryChange = false;
    locationCityChange = false;
}
void drawNotification(String Level) {
    clearUIArea();
    if (Level == "Info") {
        tft.drawRoundRect(2, 62, (screenX - 4), (screenY - 62 - 42), 20, WHITE);
        tft.drawRoundRect(2, 62, (screenX - 4), 80, 20, WHITE);
        tft.setTextColor(WHITE);
        tft.setTextSize(3);
        writeCentreText("INFORMATION", 80);
    }
}
void Brakes(bool Change)
{
    if (Change) {
        tft.setTextSize(3);
        truck_AirPressure = truck["AirPressure"].as<String>();
        tft.setCursor(45, 200);
        tft.print(truck_AirPressure);
        truck_BrakeTemperature = truck["BrakeTemperature"].as<String>();
        tft.setCursor(45, 100);
        tft.print(truck_BrakeTemperature + (char)247 + "C");
    }
    if (!truck["AirPressure"].as<String>().equals(truck_AirPressure) && truck["AirPressure"].as<String>() != NULL) {
        tft.setTextSize(3);
        removeText(truck_AirPressure, 45, 200);
        truck_AirPressure = truck["AirPressure"].as<String>();
        tft.setCursor(45, 200);
        tft.print(truck_AirPressure + "psi");
    }

    if (!truck["BrakeTemperature"].as<String>().equals(truck_BrakeTemperature) && truck["BrakeTemperature"].as<String>() != NULL) {
        tft.setTextSize(3);
        removeText(truck_BrakeTemperature + (char)247 + "C", 45, 100);
        truck_BrakeTemperature = truck["BrakeTemperature"].as<String>();
        tft.setCursor(45, 100);
        tft.print(truck_BrakeTemperature + (char)247 + "C");
    }
}
void Driving(bool Change)
{
    if (Change) {
        truck_Fuel = truck["Fuel"].as<float>();
        truck_Range = truck["Range"].as<String>();
        truck_Speed = truck["Speed"].as<String>();
        tft.setTextSize(2);
        writeCentreText("Range: " + truck_Range + " Miles", 270);
        tft.setTextSize(12);
        writeCentreText(truck_Speed, 120);
        FuelBar();
        if (truck_ParkingB == false) {
            tft.fillRect(208, 200, 64, 50, BLACK);
        }
        else {
            tft.drawBitmap(208, 200, parkingBrake, 64, 50, RED);
        }
        if (truck_EngineB == false) {
            tft.fillRect(278, 200, 64, 50, BLACK);
        }
        else {
            tft.drawBitmap(278, 200, engineBrake, 64, 50, WHITE);
        }
        if (truck_airPressureWarn == "Normal") {
            tft.fillRect(138, 200, 64, 50, BLACK);
        }
        else {
          if (truck_airPressureWarn == "Warning") {
            tft.drawBitmap(138, 200, airPressure, 64, 50, YELLOW);
          }
          else if (truck_airPressureWarn == "Emergency")
          {
            tft.drawBitmap(138, 200, airPressure, 64, 50, RED);
          }
        }
        if (truck_Retarder == 0) {
            tft.fillRect(348, 200, 64, 50, BLACK);
        }
        else {
            tft.drawBitmap(348, 200, retarderBrake, 64, 50, WHITE);
        }
        
    }
    else {
        if ((truck["Fuel"].as<float>() != truck_Fuel) && truck["Fuel"].as<String>() != NULL) {
            FuelBar();
        }
        if (!truck["Range"].as<String>().equals(truck_Range) && truck["Range"].as<String>() != NULL) {
            tft.setTextSize(2);
            removeCentreText("Range: " + truck_Range, 270);
            truck_Range = truck["Range"].as<String>();
            writeCentreText("Range: " + truck_Range + " Miles", 270);
        }
        if (!truck["Speed"].as<String>().equals(truck_Speed) && truck["Speed"].as<String>() != NULL) {
            tft.setTextSize(12);
            removeCentreText(truck_Speed, 120);
            truck_Speed = truck["Speed"].as<String>();
            writeCentreText(truck_Speed, 120);
        }
         if (doc["warning"]["AirPressure"] != truck_airPressureWarn) {
            truck_airPressureWarn = doc["warning"]["AirPressure"].as<String>();
            if (truck_airPressureWarn == "Normal") {
              tft.fillRect(138, 200, 64, 50, BLACK);
            }
            else {
              if (truck_airPressureWarn == "Warning") {
                tft.drawBitmap(138, 200, airPressure, 64, 50, YELLOW);
              }
              else if (truck_airPressureWarn == "Emergency")
              {
                tft.drawBitmap(138, 200, airPressure, 64, 50, RED);
              }
            }
        }
        if (truck["ParkingB"] != truck_ParkingB) {
            truck_ParkingB = truck["ParkingB"];
            if (truck_ParkingB == false) {
                tft.fillRect(208, 200, 64, 50, BLACK);
            }
            else {
                tft.drawBitmap(208, 200, parkingBrake, 64, 50, RED);
            }
        }
        if (truck["EngineB"] != truck_EngineB) {
            truck_EngineB = truck["EngineB"];
            if (truck_EngineB == false) {
                tft.fillRect(278, 200, 64, 50, BLACK);
            }
            else {
                tft.drawBitmap(278, 200, engineBrake, 64, 50, WHITE);
            }
        }
        if (truck["Retarder"] != truck_Retarder) {
            truck_Retarder = truck["Retarder"];
            if (truck_Retarder == 0) {
                tft.fillRect(348, 200, 64, 50, BLACK);
            }
            else {
                tft.drawBitmap(348, 200, retarderBrake, 64, 50, WHITE);
            }
        }
    }
}
//middle - 16
//427 + 24 = 451 - 435
void FuelBar()
{
    truck_Fuel = truck["Fuel"].as<float>();
    tft.fillRoundRect(screenX - 53, 66, 48, ((212 - 2) - ((212 - 2) * truck_Fuel)), 10, BLACK);
    tft.fillRoundRect(screenX - 53, (65 + (212 - ((212 - 2) * truck_Fuel))), 50 - 2, (212 - 0) - ((212 - ((212 - 3) * truck_Fuel))), 8, temp2color(truck_Fuel * 100, 0, 100));
    tft.drawRoundRect(screenX - 54, 64, 50, 212, 10, WHITE);
    tft.drawBitmap(435, 160, fuel, 32, 32, WHITE);
}
void writeCentreText(const String& buf, int y)
{
    int16_t x1, y1;
    uint16_t w, h;
    tft.getTextBounds(buf, screenX, y, &x1, &y1, &w, &h);
    tft.setCursor((screenX / 2) - (w / 2), y - (h / 2));
    tft.print(buf);
}
void writeCentrePointText(const String& buf, int x, int y)
{
    int16_t x1, y1;
    uint16_t w, h;
    tft.getTextBounds(buf, x, y, &x1, &y1, &w, &h);
    tft.setCursor(x - ((w / 2) / 1.25), y - ((h / 2) / 2));
    tft.print(buf);
}
void removeCentrePointText(const String& buf, int x, int y)
{
    int16_t x1, y1;
    uint16_t w, h;
    tft.getTextBounds(buf, x, y, &x1, &y1, &w, &h);
    tft.fillRect(x - ((w / 2) / 1.25), y - ((h / 2) / 2), w, h, BLACK);
}
void writeCentreScreenText(const String& buf)
{
    int16_t x1, y1;
    uint16_t w, h;
    tft.getTextBounds(buf, screenX, screenY, &x1, &y1, &w, &h);
    tft.setCursor((screenX / 2) - (w / 2), (screenY / 2) - (h / 2));
    tft.print(buf);
}
void removeText(const String& buf, uint16_t x, uint16_t y)
{
    int16_t x1, y1;
    uint16_t w, h;
    tft.getTextBounds(buf, x, y, &x1, &y1, &w, &h);
    tft.fillRect(x, y, w, h, BLACK);
}
void removeCentreText(const String& buf, uint16_t y)
{
    int16_t x1, y1;
    uint16_t w, h;
    tft.getTextBounds(buf, screenX, y, &x1, &y1, &w, &h);
    tft.fillRect((screenX / 2) - (w / 2), y - (h / 2), w, h, BLACK);
}
void drawMainUI()
{
    tft.drawRoundRect(0, 0, 480, 320, 20, WHITE); //Screen Enclosure
    tft.drawRoundRect(0, (screenY - 40), 480, 40, 20, WHITE); //Bottom enclosure
    tft.drawRoundRect(0, 0, 480, 60, 20, WHITE); //Top Enclosure
    tft.drawRoundRect(10, 10, 80, 40, 20, WHITE);
    //tft.drawBitmap(370, 14, cruiseControl, 37, 32, WHITE);
    lastUIRefresh = millis();
}
void clearUIArea()
{
    tft.fillRect(2, 61, (screenX - 4), (screenY - 61 - 41), BLACK);
}
